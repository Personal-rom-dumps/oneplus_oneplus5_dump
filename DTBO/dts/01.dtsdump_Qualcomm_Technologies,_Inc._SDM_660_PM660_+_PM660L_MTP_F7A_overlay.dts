/dts-v1/;

/ {
	model = "Qualcomm Technologies, Inc. SDM 660 PM660 + PM660L MTP F7A overlay";
	compatible = "qcom,sdm660-mtp\0qcom,sdm660\0qcom,mtp";
	qcom,board-id = <0x20008 0x00>;
	qcom,pmic-id = <0x1001b 0x101011a 0x00 0x00 0x1001b 0x201011a 0x00 0x00 0x1001b 0x102001a 0x00 0x00>;

	fragment@0 {
		target = <0xffffffff>;

		__overlay__ {
			status = "disabled";
		};
	};

	__fixups__ {
		slim_aud = "/fragment@0:target:0";
	};
};
